/*
01_LED
    功能
        LED闪烁和流水灯
    目的
        1 了解寄存器
        2 学习快捷方便的一些操作
		3 练习led的操作
*/

#include "reg52.h" // reg52.h此文件中定义了单片机的一些特殊功能寄存器

typedef unsigned int u16; //对数据类型进行声明定义
typedef unsigned char u8; // 51单片机是八位机，int2个字节

#define led P2 //将P2口定义为led 后面就可以使用led代替P2口
/*sbit led=P2^0;将单片机的P0.0端口定义为led*/

/*******************************************************************************
* 函 数 名       : delay
* 函数功能		 : 延时函数
* 输    入       : unsigned int
* 输    出    	 : 无
* 注			 ：S = 0.00001T + 0.00002 = 1E-05x + 2E-05
*******************************************************************************/
void delay(u16 i);

/*******************************************************************************
* 函 数 名       : main
* 函数功能		 : 主函数
* 输    入       : 
* 输    出    	 : 
*******************************************************************************/
void main(void)
{
	u8 i;

	while (1)
	{
		led = 0XFF;

		for (i = 0; i < 16; i++)
		{
			led = ~led;
			delay(50000); //大约延时450ms
		}
		for (i = 0; i < 8; i++)
		{
			led = ~(0X01 << i); //将1右移i位，然后将结果赋值到P2口
			delay(50000);
		}
	}
}

void delay(u16 i)
{
	while (i--)
		;
}

// 2021年8月10号17点04分