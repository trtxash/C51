/*
02_蜂鸣器和独立按键
    功能
        按下任意一个独立按键蜂鸣器发出哆来咪发唆拉稀，再按下停止，不发声时led灯亮
    目的
        1 练习独立按键和蜂鸣器
        2 测试一下延时函数的延时时间参数

*/

#include "reg52.h"

////////////////////////////////////////////////////////////////////////////////
typedef unsigned long int u32;
typedef unsigned int u16;
typedef unsigned char u8;

sbit beep = P2 ^ 0;
sbit text1 = P0 ^ 0;
sbit text2 = P0 ^ 1;

u8 test;

/*******************************************************************************
 * 函 数 名      : Timer1Init
 * 函数功能      : 定时器初始化函数
 * 输    入      :
 * 输    出      :
 *******************************************************************************/
void Timer1Init(void)
{
    TMOD |= 0X10; // 设置工作方式为1，16位定时器,定时器读取内部时钟，计时器读取管脚脉冲
    TL1 = 0X18;   // 定时器1低八位赋初值，10ms
    TH1 = 0XFC;   // 定时器1高八位赋初值
    ET1 = 1;      // 定时器1中断打开
    EA = 1;       // 总中断打开
    TR1 = 1;      // 控制定时器，1为打开
}

/*******************************************************************************
* 函 数 名       : main
* 函数功能		 : 主函数
* 输    入       : 
* 输    出    	 : 
*******************************************************************************/
void main(void)
{
//		test = 0;
		P0 =0;
//		Timer1Init();
    while (1)
    {
        if (text1)
        {
            P1 = 1;
        }
        if (text2)
        {
            P1 = 1;
        }
				if (text1 == 0 && text2 == 0)
				{
						P1 = 0;
				}
    }
}

/*******************************************************************************
 * 函 数 名      : Timer1
 * 函数功能      : 计数器1中断函数
 * 输    入      :
 * 输    出      :
 *******************************************************************************/
void Timer1(void) interrupt 3
{
		TL1 = 0X18;   // 定时器1低八位赋初值，10ms
    TH1 = 0XFC;   // 定时器1高八位赋初值
    if (test)
    {
        test = 0;
        beep = ~beep;
				P0 =0;
    }
}