/*
09_wiegang读卡器
    功能
        实现对韦根卡的识别
    目的

*/
#include <REGX52.H>
#include <stdio.h> /*标准输入输出定义*/

////////////////////////////////////////////////////////////////////////////////
sbit DATA0 = P3 ^ 2; //数据线0
sbit DATA1 = P3 ^ 3; //数据线1

////////////////////////////////////////////////////////////////////////////////
typedef unsigned int u16;
typedef unsigned char u8;

////////////////////////////////////////////////////////////////////////////////
/*定义韦根卡的一个结构体*/
struct wiegand_dev
{
        char wiegand[26]; // 定义Weigand  26Bits 数据
        unsigned char state;
        int global_var; // 全局计数器 计数组长度
};
static struct wiegand_dev *rf_card;
/*结构体，左边指针用->，左边变量用.*/

////////////////////////////////////////////////////////////////////////////////

/******************************************************************************
 *函数名称：initial(void)
 *函数功能：中断初始化
 *入口函数：无
 *出口函数：无
 ******************************************************************************/
void initial(void)
{
        IT0 = 0; // Wiegand-Data0        低电平触发中断
        EX0 = 1; //外部中断0允许
        IT1 = 0; // Wiegand-Data1 低电平触发中断
        EX1 = 1; //外部中断1允许
        EA = 1;  //开CPU中断
}

/******************************************************************************
 *函数名称：udelay(u16 num)
 *函数功能：延时函数 延时num  us
 *入口函数：num
 *出口函数：无
 ******************************************************************************/
void udelay(u16 num)
{
        num = num / 5;
        while (--num)
                ;
}

/******************************************************************************
 *函数名称：main( )
 *函数功能：主函数
 *入口函数：无
 *出口函数：无
 ****************************************************************************/
void main()
{
        while (1)
        {
                initial();
                rf_card->global_var = 0;
                //等待中断
        }
}

/******************************************************************************
 *函数名称：Wiegand_Data0( )
 *函数功能：韦根卡数据0中断处理
 *入口函数：无
 *出口函数：无
 ******************************************************************************/
void Wiegand_Data0() interrupt 0 using 1 //中断0处理函数,使用第一组寄存器，main函数使用0组寄存器，写好寄存器组可以省去寄存器入栈，提高速度
{
        EX0 = 0; //关中断0
        udelay(5);
        if (DATA0 == 0) //如果INT0为低，标示0线中断
        {
                rf_card->wiegand[rf_card->global_var] = '0'; //往数组里填0
                rf_card->global_var = rf_card->global_var + 1;
        }
        udelay(500);  //延时1500uS（去掉中断后的处理时间）
        EX0 = 1;      //开中断0
        udelay(2500); //延时2500uS(max值，去掉前期处理时间)
}

/******************************************************************************
 *函数名称：Wiegand_Data1( )
 *函数功能：韦根卡数据1中断处理
 *入口函数：无
 *出口函数：无
 ******************************************************************************/
void Wiegand_Data1() interrupt 2 using 2 //中断1处理函数,使用第二组寄存器
{
        EX1 = 0; //关中断1
        udelay(5);
        if (DATA1 == 0)
        {
                rf_card->wiegand[rf_card->global_var] = '1';
                rf_card->global_var = rf_card->global_var + 1;
        }
        udelay(500);
        EX1 = 1; //开中断0
}

// 2022年6月26号11点35分