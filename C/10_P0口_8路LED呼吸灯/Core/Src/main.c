/*
10_P0口_8路LED呼吸灯
	功能
		实现8路led呼吸灯效果
	目的
		练习算法，练习任务结构
*/
#include <main.h>

/******************************************************************************
 *函数名称：main( )
 *函数功能：主函数
 *入口函数：无
 *出口函数：无
 ****************************************************************************/
void main()
{
	Timer0_Init(1); // 12M晶振下，100us

	while (1)
	{
		// LEDCycle_PWM_task(); // 或者在定时器1中断中开启
	}
}

/*******************************************************************************
 * 函 数 名      : LEDCycle_PWM_task
 * 函数功能      : LEDCycle_PWM_task任务函数，运行10次一个周期
 * 输    入      : 0~100,10步长，
 * 输    出      :
 *******************************************************************************/
void LEDCycle_PWM_task(void)
{
	static u8 times = 0, cycle = 0, cycle_state = 1; // 记录运行次数,循环次数，循环状态
	static u8 LED_DutyCycle[8] = {0};				 // 记录每个灯占空比信息
	u8 v, i;
	float temp;

	if (times % 10 == 0) // 10 次，1ms
	{
		for (i = 0; i < 8; i++) // 计算占空比赋值
		{
			if (cycle + i < 8)				  // 加入时间（次数）变量
				temp = 14.2857 * (cycle + i); // 初始0~7对应0~100
			else if (cycle + i < 16)
				temp = -14.2857 * (cycle - 8 + i) + 100;

			if ((u8)temp % 10 < 5) // 十位做四舍五入
				LED_DutyCycle[i] = (u8)temp - (u8)temp % 10;
			else
				LED_DutyCycle[i] = (u8)temp - (u8)temp % 10 + 10;
		}

		if (times / 10 % 10 == 0) // 100 次，10ms
		{
			times = 0; // 归零
			if (cycle == 8)
				cycle_state = 0;
			else if (cycle == 0)
				cycle_state = 1;

			if (cycle_state)
				cycle++;
			else
				cycle--;
		}
	}

	for (i = 0, v = 0; i < 8; i++)
	{
		if (LED_DutyCycle[i] != 0)
		{
			v |= 0X80;
			LED_DutyCycle[i] -= 10;
		}

		if (i < 7)
			v >>= 1;
	}
	P2 = v;

	times++;
}

/*******************************************************************************
 * 函 数 名      : Timer0_Init
 * 函数功能      : 定时器初始化函数
 * 输    入      : unsigned char
 * 输    出      :
 *******************************************************************************/
void Timer0_Init(u8 x)
{
	TMOD |= 0X02; // 设置工作方式为2，8位自动重装定时器,定时器读取内部时钟，计时器读取管脚脉冲
	TL0 = 0X9C;	  // 定时器0低八位赋初值,12M晶振下，100us
	TH0 = 0X9C;	  // 定时器0高八位赋初值,12M晶振下，100us
	ET0 = 1;	  // 定时器0中断打开
	EA = 1;		  // 总中断打开
	TR0 = x;	  // 控制定时器，1为打开
}

/******************************************************************************
 *函数名称：Timer0_ISR
 *函数功能：模式2，8位自动重装。定时计数100us,1ms一个周期，占空比步长10%
 *入口函数：无
 *出口函数：无
 ******************************************************************************/
void Timer0_ISR(void) interrupt 1
{
	LEDCycle_PWM_task();
}

// 2022年11月29号19点25分