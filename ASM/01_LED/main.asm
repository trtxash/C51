		ORG	0000H;下面那条指令放到0000H
		AJMP START
		ORG 000BH;下面那条指令放到000BH
		AJMP interrupt_1
		ORG 0100H;下面那条指令放到0100H
START:
;参数初始化
		TIME DATA 30H;定义叫做TIME的变量，放在30H
		BianHua DATA 31H;定义叫做BianHua的变量，放在31H
		MOV	TIME,#4;变量TIME赋值，4为一个250ms
		MOV	BianHua,#66;变量BianHua赋值，57种变化
;定时器初始化		
		ORL TMOD,#02H;设置工作方式为2，8位自动重装定时器
		MOV TL0,#06H;定时器0低八位赋初值，0.25ms延时
		MOV TH0,#06H;定时器0高八位赋初值，自动重装
		SETB ET0;定时器0中断打开
		SETB EA;总中断打开
		SETB TR0;控制定时器

MAIN:
		MOV R3,A;保护A
		
DELAY:
;定时器查询延时
		MOV A,#250;累加器赋值250用于相减对比
		SUBB A,R0;A减去R0
		JZ DELAY_TEMP0;判断R0是否为250，是则跳转到DELAY_TEMP0
		AJMP DELAY;否则循环		
DELAY_TEMP0:
		MOV R0,#0;复位R0
		INC R1;R1加一，4次为250ms
		MOV A,TIME;TIME值给A
		SUBB A,R1;A减去R1
		JZ LED;判断R1是否和TIME相等，是则跳转到LED
		AJMP DELAY;否则重新循环
		
LED:
;LED数据赋值
		MOV R1,#00H;复位R1
		MOV A,R3;
		
		MOV DPTR,#TABLE0;查表0初始化
		MOVC A,@A+DPTR;查表
		MOV P0,A;将表中数据送入led0
		
		MOV A,R3;
		
		MOV DPTR,#TABLE1;查表1初始化
		MOVC A,@A+DPTR;查表
		MOV P1,A;将表中数据送入led1
		
		MOV A,R3;
		
		MOV DPTR,#TABLE2;查表1初始化
		MOVC A,@A+DPTR;查表
		MOV P2,A;将表中数据送入led2
		
		MOV A,R3;
		
		MOV DPTR,#TABLE3;查表1初始化
		MOVC A,@A+DPTR;查表
		MOV P3,A;将表中数据送入led3
		
		MOV A,R3;利用R3暂存A，A自增进行查表
		INC A;A+1
		MOV R3,A;
		
		CJNE A,BianHua,MAIN;比较A是否为57，不相等转到MAIN
		CLR A;否则A清零
		
		AJMP MAIN;循环运行
		
TABLE0:
		DB	0FFH,000H,000H,0FFH,0FFH,0FFH,0FFH,000H;1
		DB	0FEH,0FDH,0FBH,0F7H,0EFH,0DFH,0BFH,07FH
		DB	0FFH,0FFH,0FFH,0FFH,0FFH,0FFH,0FFH,0FFH
		DB	0FFH,0FFH,0FFH,0FFH,0FFH,0FFH,0FFH,0FFH	
		DB	0FFH,0FFH,0FFH,0FFH,0FFH,0FFH,0FFH,0FFH
		DB	0FFH,000H,0FFH,0FFH,0FFH,000H,0FFH,0FFH;6
		DB	0FEH,0FCH,0F8H,0F0H,0F0H,0E0H,0C0H,080H
		DB	000H,001H,003H,007H,00FH,00FH,01FH,03FH
		DB	07FH,0FFH	

TABLE1:
		DB	0FFH,000H,000H,0FFH,0FFH,0FFH,0FFH,000H;1
		DB	0FFH,0FFH,0FFH,0FFH,0FFH,0FFH,0FFH,0FFH
		DB	0FEH,0FDH,0FBH,0F7H,0EFH,0DFH,0BFH,07FH
		DB	0FFH,0FFH,0FFH,0FFH,0FFH,0FFH,0FFH,0FFH
		DB	0FFH,0FFH,0FFH,0FFH,0FFH,0FFH,0FFH,0FFH
		DB	0FFH,000H,0FFH,0FFH,0FFH,000H,0FFH,0FFH;6
		DB	07FH,03FH,01FH,00FH,00FH,007H,003H,001H
		DB	000H,080H,0C0H,0E0H,0F0H,0F0H,0F8H,0FCH
		DB	0FEH,0FFH
			
TABLE2:
		DB	0FFH,0FFH,0FFH,000H,000H,0FFH,0FFH,000H;1
		DB	0FFH,0FFH,0FFH,0FFH,0FFH,0FFH,0FFH,0FFH
		DB	0FFH,0FFH,0FFH,0FFH,0FFH,0FFH,0FFH,0FFH
		DB	0FEH,0FDH,0FBH,0F7H,0EFH,0DFH,0BFH,07FH
		DB	0FFH,0FFH,0FFH,0FFH,0FFH,0FFH,0FFH,0FFH
		DB	0FFH,000H,0FFH,0FFH,000H,000H,0FFH,0FFH;6
		DB	0FFH,0FEH,0FCH,0F8H,0F0H,0E0H,040H,000H
		DB	000H,000H,001H,003H,007H,00FH,01FH,0BFH
		DB	0FFH,0FFH
			
TABLE3:
		DB	0FFH,0FFH,0FFH,0F0H,0F0H,00FH,00FH,000H;1
		DB	0FFH,0FFH,0FFH,0FFH,0FFH,0FFH,0FFH,0FFH
		DB	0FFH,0FFH,0FFH,0FFH,0FFH,0FFH,0FFH,0FFH
		DB	0FFH,0FFH,0FFH,0FFH,0FFH,0FFH,0FFH,0FFH
		DB  0FEH,0FDH,0FBH,0F7H,0EFH,0DFH,0BFH,07FH
		DB	0FFH,000H,0FFH,00FH,000H,000H,0FFH,0FFH;6
		DB	0FFH,0FFH,0F7H,0E3H,041H,000H,000H,000H
		DB	000H,000H,000H,008H,01CH,0BEH,0FFH,0FFH
		DB	0FFH,0FFH
		
interrupt_1:
		INC R0;R0加一
		RETI

		END